## reference-designs/MagNET_M5DialFiddlerCrab/ArtemisNano_Hive_Multisense/boards/sparkfun/artemis_nano/board.yml
```yaml
board:
  name: sparkfun_artemis_nano
  full_name: SparkFun RedBoard Artemis Nano
  vendor: sparkfun
  socs:
  - name: apollo3_blue
```

## reference-designs/MagNET_M5DialFiddlerCrab/ArtemisNano_Hive_Turret_Test/boards/sparkfun/artemis_nano/Kconfig.sparkfun_artemis_nano
```kconfig
# SPDX-License-Identifier: Apache-2.0

config BOARD_SPARKFUN_ARTEMIS_NANO
	select SOC_APOLLO3_BLUE
```

## reference-designs/MagNET_OTA_WaveC6LED/components/magnet_ui/Kconfig
```kconfig
menu "MagNET board"

choice MAGNET_BOARD
    prompt "Waveshare board variant"
    default MAGNET_BOARD_WAVEC6LED
    help
        The two ESP32-C6 1.47" boards look alike and are not: different LCD
        controller, different SPI pins, one has an RGB LED and the other has
        touch + IMU + battery. Pick the one on the bench. Wrong choice = black
        screen, nothing worse.

config MAGNET_BOARD_WAVEC6LED
    bool "ESP32-C6-LCD-1.47 (ST7789T, WS2812 on GPIO8)"
config MAGNET_BOARD_WAVEC6TOUCH
    bool "ESP32-C6-Touch-LCD-1.47 (JD9853, AXS5106L touch, no RGB LED)"
endchoice

config MAGNET_BOARD_NAME
    string
    default "WAVEC6LED" if MAGNET_BOARD_WAVEC6LED
    default "WAVEC6TOUCH" if MAGNET_BOARD_WAVEC6TOUCH

config MAGNET_HAS_RGB_LED
    bool
    default y if MAGNET_BOARD_WAVEC6LED
    default n

endmenu
```

## reference-designs/MagNET_Thread_COaP_hanasu_esp32c6/sdkconfig.defaults
```kconfig
CONFIG_MBEDTLS_ECDSA_DETERMINISTIC=y   # RFC 6979 signing for device identity (E-D)
```
