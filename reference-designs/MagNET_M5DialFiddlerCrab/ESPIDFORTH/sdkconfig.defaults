## reference-designs/MagNET_M5DialFiddlerCrab/ESPIDFORTH/sdkconfig.defaults
```kconfig
# Common defaults for ESPIDFORTH
CONFIG_ESP_MAIN_TASK_STACK_SIZE=8192
CONFIG_FREERTOS_HZ=1000

# Optimization for size
CONFIG_COMPILER_OPTIMIZATION_SIZE=y

# Partition table - single factory app
CONFIG_PARTITION_TABLE_SINGLE_APP=y

# Flash - 4MB default
CONFIG_ESPTOOLPY_FLASHSIZE_4MB=y
```

## reference-designs/MagNET_M5DialFiddlerCrab/ESPIDFORTH/sdkconfig.defaults.esp32c3
```kconfig
# ESP32-C3 specific: no PSRAM, conserve memory
CONFIG_ESP_WIFI_ENABLED=n
CONFIG_BT_ENABLED=n
CONFIG_ESP_MAIN_TASK_STACK_SIZE=8192

# C3 uses USB-serial-JTAG for console (not UART0)
CONFIG_ESP_CONSOLE_USB_SERIAL_JTAG=y
```

## reference-designs/MagNET_M5DialFiddlerCrab/ESPIDFORTH/sdkconfig.defaults.esp32s3
```kconfig
# ESP32-S3 specific: enable PSRAM for Forth dictionary
CONFIG_ESP32S3_SPIRAM_SUPPORT=y
CONFIG_SPIRAM=y
CONFIG_SPIRAM_MODE_OCT=y
CONFIG_SPIRAM_SPEED_80M=y

# Allow malloc to use PSRAM
CONFIG_SPIRAM_USE_MALLOC=y
CONFIG_SPIRAM_MALLOC_ALWAYSINTERNAL=4096
CONFIG_SPIRAM_MALLOC_RESERVE_INTERNAL=32768

CONFIG_ESP_MAIN_TASK_STACK_SIZE=16384

# S3 console over USB-serial-JTAG (built-in USB on most S3 boards)
CONFIG_ESP_CONSOLE_USB_SERIAL_JTAG=y
```

## reference-designs/MagNET_M5DialFiddlerCrab/EspJanet/sdkconfig.defaults.esp32c6
```kconfig
# ESP32-C6 specific: no PSRAM, conserve memory
CONFIG_ESP_WIFI_ENABLED=n
CONFIG_BT_ENABLED=n

CONFIG_ESP_MAIN_TASK_STACK_SIZE=8192
```

## reference-designs/MagNET_M5DialFiddlerCrab/EspJanet/sdkconfig.defaults.esp32s3
```kconfig
# ESP32-S3 specific: enable PSRAM for Janet heap
CONFIG_ESP32S3_SPIRAM_SUPPORT=y
CONFIG_SPIRAM=y
CONFIG_SPIRAM_MODE_OCT=y
CONFIG_SPIRAM_SPEED_80M=y

# Allow malloc to use PSRAM
CONFIG_SPIRAM_USE_MALLOC=y
CONFIG_SPIRAM_MALLOC_ALWAYSINTERNAL=4096
CONFIG_SPIRAM_MALLOC_RESERVE_INTERNAL=32768

# Larger main task stack for Janet REPL
CONFIG_ESP_MAIN_TASK_STACK_SIZE=16384

# S3 console over USB-serial-JTAG
CONFIG_ESP_CONSOLE_USB_SERIAL_JTAG=y
```

## reference-designs/MagNET_M5DialFiddlerCrab/M5Atom_Echo_Hex_Hive_ATH20/sdkconfig.defaults
```kconfig
# M5Atom Echo (ESP32-PICO-D4) + M5 Unit Hex (37× SK6812)
CONFIG_ESP_MAIN_TASK_STACK_SIZE=16384
CONFIG_FREERTOS_HZ=1000
CONFIG_COMPILER_OPTIMIZATION_SIZE=y
CONFIG_ESPTOOLPY_FLASHSIZE_4MB=y

# Classic ESP32 has no USB-serial-JTAG — use UART0 via CP2104 bridge.
CONFIG_ESP_CONSOLE_UART_DEFAULT=y
CONFIG_ESP_CONSOLE_UART_BAUDRATE=115200

# Partition table
CONFIG_PARTITION_TABLE_CUSTOM=y
CONFIG_PARTITION_TABLE_CUSTOM_FILENAME="partitions.csv"

# BLE — NimBLE only, classic BT off
CONFIG_BT_ENABLED=y
CONFIG_BT_NIMBLE_ENABLED=y
# Only one provisioning client at a time — saves a few KB per slot on
# this DRAM-tight classic ESP32. Phone/laptop disconnects before next
# device, so 1 is enough for the provisioning flow.
CONFIG_BT_NIMBLE_MAX_CONNECTIONS=1
CONFIG_BT_BLUEDROID_ENABLED=n
CONFIG_BT_CTRL_MODE_EFF_BLE_ONLY=y

# WiFi RAM trim — default static RX buffer pool is 10; 4 is plenty for the
# UC2 polling pattern (one client, low RPS) and saves ~10 KB of DRAM so the
# BT/WiFi coexistence arbiter can find its contiguous block at esp_wifi_start.
CONFIG_ESP_WIFI_STATIC_RX_BUFFER_NUM=4

# Save RAM
CONFIG_LWIP_IPV6=n

# HTTP server (UC2 env sensor API) — same shape as lighting/boombox.
CONFIG_LWIP_MAX_SOCKETS=16
CONFIG_HTTPD_MAX_REQ_HDR_LEN=1024
```

## reference-designs/MagNET_M5DialFiddlerCrab/M5Atom_Matrix_Hive_Test/sdkconfig.defaults
```kconfig
# M5Atom Matrix — ESP32-PICO-D4 (classic dual-core Tensilica)
CONFIG_ESP_MAIN_TASK_STACK_SIZE=16384
CONFIG_FREERTOS_HZ=1000
CONFIG_COMPILER_OPTIMIZATION_SIZE=y
CONFIG_ESPTOOLPY_FLASHSIZE_4MB=y

# Classic ESP32 has no USB-serial-JTAG — use UART0 via CP2104 bridge.
CONFIG_ESP_CONSOLE_UART_DEFAULT=y
CONFIG_ESP_CONSOLE_UART_BAUDRATE=115200

# Partition table (extra space for BLE + WiFi + mbedTLS + mDNS)
CONFIG_PARTITION_TABLE_CUSTOM=y
CONFIG_PARTITION_TABLE_CUSTOM_FILENAME="partitions.csv"

# BLE — NimBLE only, classic BT off to save RAM.
CONFIG_BT_ENABLED=y
CONFIG_BT_NIMBLE_ENABLED=y
CONFIG_BT_NIMBLE_MAX_CONNECTIONS=3
CONFIG_BT_CONTROLLER_ONLY=n
CONFIG_BT_BLUEDROID_ENABLED=n

# Classic ESP32 BLE controller mode: BLE-only, no classic BT.
CONFIG_BT_CTRL_MODE_EFF_BLE_ONLY=y

# Save RAM
CONFIG_LWIP_IPV6=n
```

## reference-designs/MagNET_M5DialFiddlerCrab/M5Capsule_Hive_Scribe/sdkconfig.defaults
```kconfig
# M5Capsule (ESP32-S3FN8 — 8 MB flash, no PSRAM)
CONFIG_ESP_MAIN_TASK_STACK_SIZE=16384
CONFIG_FREERTOS_HZ=1000
CONFIG_COMPILER_OPTIMIZATION_SIZE=y
CONFIG_ESPTOOLPY_FLASHSIZE_8MB=y

# No PSRAM on this SKU
# CONFIG_SPIRAM is not set

# Console: native USB-serial-JTAG
CONFIG_ESP_CONSOLE_USB_SERIAL_JTAG=y

# Custom partition table (extra room for hive components)
CONFIG_PARTITION_TABLE_CUSTOM=y
CONFIG_PARTITION_TABLE_CUSTOM_FILENAME="partitions.csv"

# BLE — NimBLE only (S3 has no classic BT anyway)
CONFIG_BT_ENABLED=y
CONFIG_BT_NIMBLE_ENABLED=y
CONFIG_BT_NIMBLE_MAX_CONNECTIONS=3

# Save RAM
CONFIG_LWIP_IPV6=n
```

## reference-designs/MagNET_M5DialFiddlerCrab/M5Capsule_Hive_Scribe_XR/sdkconfig.defaults
```kconfig
# M5Capsule (ESP32-S3FN8 — 8 MB flash, no PSRAM)
CONFIG_ESP_MAIN_TASK_STACK_SIZE=16384
CONFIG_FREERTOS_HZ=1000
CONFIG_COMPILER_OPTIMIZATION_SIZE=y
CONFIG_ESPTOOLPY_FLASHSIZE_8MB=y

# No PSRAM on this SKU
# CONFIG_SPIRAM is not set

# Console: native USB-serial-JTAG
CONFIG_ESP_CONSOLE_USB_SERIAL_JTAG=y

# Custom partition table (extra room for hive components)
CONFIG_PARTITION_TABLE_CUSTOM=y
CONFIG_PARTITION_TABLE_CUSTOM_FILENAME="partitions.csv"

# BLE — NimBLE only (S3 has no classic BT anyway)
CONFIG_BT_ENABLED=y
CONFIG_BT_NIMBLE_ENABLED=y
CONFIG_BT_NIMBLE_MAX_CONNECTIONS=3

# Save RAM
CONFIG_LWIP_IPV6=n

# esp_http_server (craw_imu HTTP endpoint) — bump the request-header
# buffer from the 512-byte default. Browser fetches via a cloudflared
# tunnel arrive with Cf-* / X-Forwarded-* tunnel-added headers stacked
# on top of the usual sec-ch-* / sec-fetch-* / cookie noise; the Vite
# proxy strips most of it but cloudflared's adds slip past. 2048 is
# what M5_Hive_Camera settled on for the same problem; matches the
# headroom AHT20 uses (1024) with comfortable margin.
CONFIG_HTTPD_MAX_REQ_HDR_LEN=2048
```

## reference-designs/MagNET_M5DialFiddlerCrab/M5StackDial-Blinky_Claw_OpenWR/sdkconfig.defaults
```kconfig
# Fiddler Crab Display defaults
CONFIG_ESP_MAIN_TASK_STACK_SIZE=16384
CONFIG_FREERTOS_HZ=1000
CONFIG_COMPILER_OPTIMIZATION_SIZE=y
CONFIG_ESPTOOLPY_FLASHSIZE_8MB=y
CONFIG_BT_ENABLED=n
CONFIG_LWIP_IPV6=n
CONFIG_MDNS_MAX_SERVICES=2

# Custom partition table with 2MB app partition (8MB flash has room)
CONFIG_PARTITION_TABLE_CUSTOM=y
CONFIG_PARTITION_TABLE_CUSTOM_FILENAME="partitions.csv"
```

## reference-designs/MagNET_M5DialFiddlerCrab/M5StackDial-Blinky_Claw_OpenWR/sdkconfig.defaults.esp32s3
```kconfig
# M5Dial has NO PSRAM
# CONFIG_SPIRAM is not set
CONFIG_ESP_CONSOLE_USB_SERIAL_JTAG=y
```

## reference-designs/MagNET_M5DialFiddlerCrab/M5StackDial-m5gfx-demo-ESPIDFORTH/sdkconfig.defaults
```kconfig
# Common + ESP32-S3 M5Dial defaults
CONFIG_ESP_MAIN_TASK_STACK_SIZE=16384
CONFIG_FREERTOS_HZ=1000
CONFIG_COMPILER_OPTIMIZATION_PERF=y
CONFIG_ESPTOOLPY_FLASHSIZE_8MB=y

# Custom partition table — extra room for BLE + WiFi + mbedTLS + mDNS + hive
CONFIG_PARTITION_TABLE_CUSTOM=y
CONFIG_PARTITION_TABLE_CUSTOM_FILENAME="partitions.csv"

# M5Dial has NO PSRAM — must disable
# CONFIG_SPIRAM is not set

# USB-serial-JTAG console
CONFIG_ESP_CONSOLE_USB_SERIAL_JTAG=y

# BLE — NimBLE only (classic BT not on S3 anyway).
# BLE is used for WiFi provisioning; torn down once online (see main.cpp).
CONFIG_BT_ENABLED=y
CONFIG_BT_NIMBLE_ENABLED=y
CONFIG_BT_NIMBLE_MAX_CONNECTIONS=3

# Save RAM
CONFIG_LWIP_IPV6=n
```

## reference-designs/MagNET_M5DialFiddlerCrab/M5StackDial-m5gfx-demo-ESPIDFORTH/sdkconfig.defaults.esp32s3
```kconfig
# ESP32-S3 specific — M5Dial has NO PSRAM
# Must use "# CONFIG_SPIRAM is not set" syntax for Kconfig to actually disable it
# CONFIG_SPIRAM is not set

# USB-serial-JTAG console
CONFIG_ESP_CONSOLE_USB_SERIAL_JTAG=y
```

## reference-designs/MagNET_M5DialFiddlerCrab/M5Stamp3CU_Blinky_Claw_OpenWR/sdkconfig.defaults
```kconfig
# Claw OpenWR defaults (ESP32-C3)
CONFIG_ESP_MAIN_TASK_STACK_SIZE=8192
CONFIG_FREERTOS_HZ=1000
CONFIG_COMPILER_OPTIMIZATION_SIZE=y
CONFIG_PARTITION_TABLE_SINGLE_APP=y
CONFIG_ESPTOOLPY_FLASHSIZE_4MB=y

# USB-serial-JTAG console
CONFIG_ESP_CONSOLE_USB_SERIAL_JTAG=y

# WiFi enabled, BT disabled
CONFIG_BT_ENABLED=n

# Disable IPv6 to save RAM
CONFIG_LWIP_IPV6=n

# mDNS
CONFIG_MDNS_MAX_SERVICES=2
```

## reference-designs/MagNET_M5DialFiddlerCrab/M5Stamp3CU_Blinky_E4TH/sdkconfig.defaults
```kconfig
# M5Stamp C3U defaults
CONFIG_ESP_MAIN_TASK_STACK_SIZE=16384
CONFIG_FREERTOS_HZ=1000
CONFIG_COMPILER_OPTIMIZATION_SIZE=y
CONFIG_ESPTOOLPY_FLASHSIZE_4MB=y

# USB-serial-JTAG console
CONFIG_ESP_CONSOLE_USB_SERIAL_JTAG=y

# Partition table (adds extra space for BLE/WiFi code)
CONFIG_PARTITION_TABLE_CUSTOM=y
CONFIG_PARTITION_TABLE_CUSTOM_FILENAME="partitions.csv"

# BLE — NimBLE (Phase 4A: craw_ble_provision)
CONFIG_BT_ENABLED=y
CONFIG_BT_NIMBLE_ENABLED=y
CONFIG_BT_NIMBLE_MAX_CONNECTIONS=3

# Save RAM
CONFIG_LWIP_IPV6=n
```

## reference-designs/MagNET_M5DialFiddlerCrab/M5Stamp_DigDug_BLE_Lighting/sdkconfig.defaults
```kconfig
# DigDug BLE Lighting — M5StampC3U (ESP32-C3)
CONFIG_ESP_MAIN_TASK_STACK_SIZE=16384
CONFIG_FREERTOS_HZ=1000
CONFIG_COMPILER_OPTIMIZATION_SIZE=y
CONFIG_ESPTOOLPY_FLASHSIZE_4MB=y

# USB console (ESP32-C3 native USB-serial-JTAG)
CONFIG_ESP_CONSOLE_USB_SERIAL_JTAG=y

# Partition table
CONFIG_PARTITION_TABLE_CUSTOM=y
CONFIG_PARTITION_TABLE_CUSTOM_FILENAME="partitions.csv"

# BLE — NimBLE
CONFIG_BT_ENABLED=y
CONFIG_BT_NIMBLE_ENABLED=y
CONFIG_BT_NIMBLE_MAX_CONNECTIONS=3

# Save RAM
CONFIG_LWIP_IPV6=n
```

## reference-designs/MagNET_M5DialFiddlerCrab/M5StickCPlus-Blinky_Crawdad_OpenWR/sdkconfig.defaults
```kconfig
# Crawdad OpenWR defaults (ESP32 classic / M5StickC Plus)
CONFIG_ESP_MAIN_TASK_STACK_SIZE=16384
CONFIG_FREERTOS_HZ=1000
CONFIG_COMPILER_OPTIMIZATION_SIZE=y
CONFIG_PARTITION_TABLE_CUSTOM=y
CONFIG_PARTITION_TABLE_CUSTOM_FILENAME="partitions.csv"
CONFIG_ESPTOOLPY_FLASHSIZE_4MB=y

# WiFi enabled, BT disabled, IPv6 disabled (save RAM)
CONFIG_BT_ENABLED=n
CONFIG_LWIP_IPV6=n
```

## reference-designs/MagNET_M5DialFiddlerCrab/M5_Hive_Camera/sdkconfig.defaults
```kconfig
# Shared defaults for M5_Hive_Camera across both chip targets.
CONFIG_ESP_MAIN_TASK_STACK_SIZE=16384
CONFIG_FREERTOS_HZ=1000
CONFIG_COMPILER_OPTIMIZATION_SIZE=y

# Custom partition table — plenty of room for BLE + WiFi + mbedTLS + mdns +
# esp32-camera + http server + forth. Matches the Dial 2.5 MB app partition.
CONFIG_PARTITION_TABLE_CUSTOM=y
CONFIG_PARTITION_TABLE_CUSTOM_FILENAME="partitions.csv"

# BLE — NimBLE only. Used for Phase-4A provisioning, then torn down.
CONFIG_BT_ENABLED=y
CONFIG_BT_NIMBLE_ENABLED=y
CONFIG_BT_NIMBLE_MAX_CONNECTIONS=3
CONFIG_BT_BLUEDROID_ENABLED=n

# HTTP server — larger request-header buffer tolerates Chrome's longer
# header set (cookies, sec-ch-*, user-agent) + any CORS preflight metadata.
CONFIG_HTTPD_MAX_REQ_HDR_LEN=2048
CONFIG_HTTPD_MAX_URI_LEN=512

# lwIP socket pool. Default is 10 — httpd alone wants 13 (see
# http_stream.c), and we also need sockets for mDNS, SNTP, hive TCP.
# Kconfig max is 16; values above are silently clamped to default.
CONFIG_LWIP_MAX_SOCKETS=16

# Save RAM — IPv6 not needed for LAN-scoped hive / MJPEG.
CONFIG_LWIP_IPV6=n
```

## reference-designs/MagNET_M5DialFiddlerCrab/M5_Hive_Camera/sdkconfig.defaults.atoms3r
```kconfig
# M5Stack AtomS3R Camera M12 (ESP32-S3R8, 8 MB flash, 8 MB OPI PSRAM in-package).
CONFIG_IDF_TARGET="esp32s3"
CONFIG_ESPTOOLPY_FLASHSIZE_8MB=y

# Console: native USB-serial-JTAG (no external adapter needed).
CONFIG_ESP_CONSOLE_USB_SERIAL_JTAG=y

# PSRAM — S3R8 has 8 MB OPI (octal) PSRAM baked into the package.
CONFIG_SPIRAM=y
CONFIG_SPIRAM_USE_MALLOC=y
CONFIG_SPIRAM_MALLOC_ALWAYSINTERNAL=16384
CONFIG_SPIRAM_MODE_OCT=y
CONFIG_SPIRAM_SPEED_80M=y

# Camera sensor: OV3660 (3MP, SCCB addr 0x3C). OV3660 support is compiled into
# esp32-camera unconditionally — no Kconfig required.
```

## reference-designs/MagNET_M5DialFiddlerCrab/M5_Hive_Camera/sdkconfig.defaults.esp32cam
```kconfig
# AI-Thinker ESP32-CAM (classic ESP32-WROVER, 4 MB flash, 4 MB PSRAM)
CONFIG_ESPTOOLPY_FLASHSIZE_4MB=y

# Console: UART0 via external USB-TTL adapter (no onboard bridge).
CONFIG_ESP_CONSOLE_UART_DEFAULT=y
CONFIG_ESP_CONSOLE_UART_BAUDRATE=115200

# PSRAM — required by esp32-camera for anything above QQVGA.
# AI-Thinker uses older QSPI-style (Quad) PSRAM.
CONFIG_SPIRAM=y
CONFIG_SPIRAM_USE_MALLOC=y
CONFIG_SPIRAM_MALLOC_ALWAYSINTERNAL=16384
CONFIG_SPIRAM_MODE_QUAD=y
CONFIG_SPIRAM_TYPE_ESPPSRAM64=y
CONFIG_SPIRAM_SPEED_80M=y

# BLE controller: BLE-only (classic BT off to save RAM).
CONFIG_BT_CTRL_MODE_EFF_BLE_ONLY=y
```
