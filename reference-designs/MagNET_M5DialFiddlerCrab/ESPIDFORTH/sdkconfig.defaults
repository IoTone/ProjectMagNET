## reference-designs/MagNET_M5DialFiddlerCrab/M5_Hive_Camera/sdkconfig.defaults.m5camerax
```kconfig
# M5Stack M5Camera X (classic ESP32 + OV3660, 4 MB flash, 4 MB QSPI PSRAM).
# Same SoC family as the AI-Thinker target, but with an onboard CP2104
# USB-UART bridge — no external adapter needed for flashing/console.
CONFIG_ESPTOOLPY_FLASHSIZE_4MB=y

# Console: UART0 via the onboard USB-UART bridge.
CONFIG_ESP_CONSOLE_UART_DEFAULT=y
CONFIG_ESP_CONSOLE_UART_BAUDRATE=115200

# PSRAM — required by esp32-camera for anything above QQVGA. The M5Camera
# carries older QSPI-style (Quad) PSRAM, same as AI-Thinker.
CONFIG_SPIRAM=y
CONFIG_SPIRAM_USE_MALLOC=y
CONFIG_SPIRAM_MALLOC_ALWAYSINTERNAL=16384
CONFIG_SPIRAM_MODE_QUAD=y
CONFIG_SPIRAM_TYPE_ESPPSRAM64=y
CONFIG_SPIRAM_SPEED_80M=y

# BLE controller: BLE-only (classic BT off to save RAM).
CONFIG_BT_CTRL_MODE_EFF_BLE_ONLY=y

# --- Internal-DRAM relief for rev-1 ESP32-D0WD silicon ---------------------
# This unit is an older ESP32 rev v1.0, which loses more internal DRAM to the
# mandatory SPIRAM cache workaround than the rev-3 AI-Thinker modules. With
# the stock 16 KB ALWAYSINTERNAL threshold, startup-time allocations (lwIP,
# PHY, coexist, NimBLE host) pile into internal RAM and fragment the one big
# block below the 16 KB the main-task stack needs — esp_startup_start_app then
# asserts at app_startup.c:86 (main task fails to allocate) before app_main
# even runs. Spill mid-size allocations to PSRAM to keep a contiguous
# internal block for the main stack.
#
# NOTE: deliberately NOT setting CONFIG_SPIRAM_TRY_ALLOCATE_WIFI_LWIP. It was
# used briefly as boot-headroom, but it routes every TCP segment/pbuf touch
# through 40 MHz QSPI PSRAM (with the rev-1 cache workaround on top), which
# multiplied the lwIP task's per-tick work and deepened a tiT task-WDT
# starvation observed on-bench. The Forth-BSS-to-PSRAM move below freed
# ~74 KB of internal DRAM, which both replaces the headroom and absorbs the
# WiFi/lwIP buffers staying internal.
CONFIG_SPIRAM_MALLOC_ALWAYSINTERNAL=4096

# The shared sdkconfig.defaults asks for a 16 KB main-task stack. On this
# rev-1 ESP32 the internal heap is too starved (Forth dictionary ~55 KB BSS +
# BT-controller DRAM reserve + cache workaround) to find a contiguous 16 KB
# internal block at startup, so xTaskCreate(main) fails and the kernel asserts
# at app_startup.c:86 before app_main runs. app_main only does shallow init
# (WiFi/BLE/camera all run in their own tasks), so 8 KB is plenty here.
CONFIG_ESP_MAIN_TASK_STACK_SIZE=8192

# Classic ESP32 can't DMA into PSRAM (PSRAM-DMA is S2/S3 only), so esp32-camera
# needs a contiguous *internal* DMA ring. In JPEG mode that ring is HARDCODED
# at 32 KB (target/esp32/ll_cam.c: 8 half-buffers x 4 KB — the
# CAMERA_DMA_BUFFER_SIZE_MAX Kconfig is dead code in this component version
# and does not shrink it). After Forth's ~54 KB static BSS + WiFi statics, the
# largest free internal block was ~28 KB -> cam_dma_config fails 0xffffffff.
#
# Fix: allow .bss objects tagged EXT_RAM_BSS_ATTR to live in PSRAM, and tag
# Forth's dictionary[]/code[] (forth_core.cpp) with it. That returns ~54 KB
# of contiguous internal DRAM, comfortably fitting the camera's 32 KB ring.
CONFIG_SPIRAM_ALLOW_BSS_SEG_EXTERNAL_MEMORY=y
```

## reference-designs/MagNET_M5DialFiddlerCrab/M5_Hive_Camera/sdkconfig.defaults.m5cams3
```kconfig
# M5Stack Unit CamS3 (ESP32-S3, 8 MB flash, 8 MB OPI PSRAM)
CONFIG_IDF_TARGET="esp32s3"
CONFIG_ESPTOOLPY_FLASHSIZE_8MB=y

# Console: native USB-serial-JTAG (no external adapter needed).
CONFIG_ESP_CONSOLE_USB_SERIAL_JTAG=y

# PSRAM — ESP32-S3 typically ships with OPI (octal) PSRAM.
CONFIG_SPIRAM=y
CONFIG_SPIRAM_USE_MALLOC=y
CONFIG_SPIRAM_MALLOC_ALWAYSINTERNAL=16384
CONFIG_SPIRAM_MODE_OCT=y
CONFIG_SPIRAM_SPEED_80M=y
```

## reference-designs/MagNET_M5DialFiddlerCrab/MagNET_ReSpeaker_Boombox/sdkconfig.defaults
```kconfig
# XIAO ESP32-S3 + ReSpeaker Lite Voice Kit
CONFIG_ESP_MAIN_TASK_STACK_SIZE=16384
CONFIG_FREERTOS_HZ=1000
CONFIG_COMPILER_OPTIMIZATION_SIZE=y
CONFIG_ESPTOOLPY_FLASHSIZE_8MB=y

# No PSRAM on the XIAO ESP32-S3 base SKU
# CONFIG_SPIRAM is not set

# Console: native USB-serial-JTAG over the XIAO USB-C port
CONFIG_ESP_CONSOLE_USB_SERIAL_JTAG=y

# Partition table — same shape as the scribe (room for role bundles in NVS)
CONFIG_PARTITION_TABLE_CUSTOM=y
CONFIG_PARTITION_TABLE_CUSTOM_FILENAME="partitions.csv"

# BLE — NimBLE only, used for WiFi provisioning then torn down
CONFIG_BT_ENABLED=y
CONFIG_BT_NIMBLE_ENABLED=y
CONFIG_BT_NIMBLE_MAX_CONNECTIONS=3

# Save RAM — IPv6 unused
CONFIG_LWIP_IPV6=n
```

## reference-designs/MagNET_M5DialFiddlerCrab/MagNET_Vitals_E4TH/components/craw_bh1750/Kconfig
```kconfig
menu "MagNET Vitals — BH1750 lux sensor"

config CRAW_BH1750_SDA_GPIO
    int "I²C SDA GPIO for BH1750"
    default 22
    help
        XIAO ESP32-C6 D4 → GPIO 22 by default. Adjust if your kit differs.

config CRAW_BH1750_SCL_GPIO
    int "I²C SCL GPIO for BH1750"
    default 23
    help
        XIAO ESP32-C6 D5 → GPIO 23 by default.

endmenu
```

## reference-designs/MagNET_M5DialFiddlerCrab/MagNET_Vitals_E4TH/components/craw_mr60bha2/Kconfig
```kconfig
menu "MagNET Vitals (MR60BHA2 driver)"

config CRAW_MR60_UART_PORT
    int "UART port number for MR60BHA2"
    range 0 1
    default 0
    help
        Which UART peripheral to use for the radar link. UART0 matches
        Seeed's reference (`HardwareSerial(0)`) and is what the XIAO C6
        mmWave kit pre-wires to the radar. UART0 is free for app use
        because we route the console to USB-serial-JTAG. Use UART1 only
        if your hardware has different routing.

config CRAW_MR60_RX_GPIO
    int "GPIO for UART RX (radar TX → host RX)"
    default 17
    help
        Default 17 matches the XIAO ESP32-C6 mmWave kit's pre-wired pinout
        when used with UART1. Adjust if your hardware differs.

config CRAW_MR60_TX_GPIO
    int "GPIO for UART TX (host TX → radar RX)"
    default 16
    help
        Default 16 matches the XIAO ESP32-C6 mmWave kit. Set to -1 if the
        host does not need to send commands to the radar.

endmenu
```
